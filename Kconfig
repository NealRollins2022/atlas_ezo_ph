## Kconfig
```kconfig
config PH_SENSOR
	bool "Enable Atlas EZO-pH sensor driver"
	select SENSOR
	select LOG
	select I2C
	select I2C_NRFX
	default n
	help
	  Atlas Scientific EZO-pH sensor driver.
	  All dependencies auto-enabled via select.

if PH_SENSOR

choice PH_SENSOR_TRANSPORT
	prompt "Telemetry transport"
	default PH_SENSOR_TRANSPORT_MATTER

config PH_SENSOR_TRANSPORT_MATTER
	bool "Matter/CHIP (network)"
	select NET_IPV6
	select NET_UDP
	select NET_SOCKETS
	help
	  Send telemetry via Matter/Thread when network ready.

config PH_SENSOR_TRANSPORT_SERIAL
	bool "Serial/UART (debug)"
	help
	  Output readings to UART.

endchoice

choice PH_SENSOR_MODE
	prompt "Measurement mode"
	default PH_SENSOR_MODE_CONTINUOUS

config PH_SENSOR_MODE_CONTINUOUS
	bool "Continuous (driver thread polls sensor)"
	help
	  Driver thread sends "R" repeatedly at interval.
	  Stores latest reading in ph_value; signals ph_data_ready_sem.

config PH_SENSOR_MODE_ON_DEMAND
	bool "On-demand (app polls sensor)"
	help
	  Application calls sample_fetch() when it needs a reading.

endchoice

config PH_SENSOR_MEASUREMENT_INTERVAL_MS
	int "Measurement interval (ms)"
	default 10000

config PH_SENSOR_I2C_READ_TIMEOUT_MS
	int "I2C read timeout (ms)"
	default 2000
	depends on PH_SENSOR_MODE_ON_DEMAND

config PH_SENSOR_RETRY_COUNT
	int "I2C read retry count"
	default 5

config PH_SENSOR_RETRY_DELAY_MS
	int "Retry delay (ms)"
	default 200

config PH_SENSOR_INIT_PRIORITY
	int "Device init priority"
	default 80

config PH_SENSOR_CAL_LOW
	int "Low calibration point (pH x1000)"
	default 4000

config PH_SENSOR_CAL_MID
	int "Mid calibration point (pH x1000)"
	default 7000

config PH_SENSOR_CAL_HIGH
	int "High calibration point (pH x1000)"
	default 10000

config PH_SENSOR_ACQ_THREAD_STACK_SIZE
	int "Acquisition thread stack (bytes)"
	default 2048
	depends on PH_SENSOR_MODE_CONTINUOUS

config PH_SENSOR_ACQ_THREAD_PRIORITY
	int "Acquisition thread priority"
	default 10
	depends on PH_SENSOR_MODE_CONTINUOUS

endif
```

## dts/bindings/sensor/atlas,ezo-ph-i2c.yaml
```yaml
# I2C bus binding for Atlas EZO-pH sensor.
#
# Zephyr selects this file automatically when the DT node's parent bus
# is I2C, matched by compatible + on-bus together.
#
# Shared base properties are in atlas,ezo-ph.yaml (no compatible declared
# there — it is a pure mixin to avoid conflicting with this file).
#
# Note: 'reg' is intentionally NOT declared here. base.yaml already
# declares reg as type 'array' (the standard DT type for bus addresses).
# Redeclaring it as type 'int' causes a binding conflict:
#   "type from included file overwritten ('array' replaced with 'int')"
# The DT compiler enforces reg's presence for all I2C child nodes
# automatically — no explicit declaration is needed in sensor bindings.

description: Atlas EZO-pH sensor (I2C mode)

compatible: "atlas,ezo-ph"

include: atlas,ezo-ph.yaml

on-bus: i2c
```

## dts/bindings/sensor/atlas,ezo-ph-uart.yaml
```yaml
# UART bus binding for Atlas EZO-pH sensor.
#
# Zephyr selects this file automatically when the DT node's parent bus
# is UART, matched by compatible + on-bus together.
#
# current-speed belongs on the &uart1 controller node in the overlay,
# not here — it is a bus controller property, not a device property.

description: Atlas EZO-pH sensor (UART mode)

compatible: "atlas,ezo-ph"

include: base.yaml

on-bus: uart
```

## dts/bindings/sensor/atlas,ezo-ph.yaml
```yaml
# Base binding for Atlas EZO-pH sensor.
#
# This file is a shared mixin — it does NOT declare 'compatible' or 'on-bus'.
# It is included by atlas,ezo-ph-i2c.yaml and atlas,ezo-ph-uart.yaml which
# each declare the compatible string and their respective on-bus value.
# Zephyr selects the correct bus-specific file automatically based on the
# parent bus of the DT node.
#
# Do not reference this file directly in overlays.

description: Atlas EZO-pH sensor base properties

include: base.yaml
```
